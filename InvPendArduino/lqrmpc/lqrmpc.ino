#include <Thread.h>
#include <ThreadController.h>
#include <RobojaxBTS7960.h>

//Limit Switch Pins
#define limLPin 53
#define limRPin 52

//DC Motor Pins
#define RPWM 3 // define pin 3 for RPWM pin (output)
#define R_EN 4 // define pin 2 for R_EN pin (input)
#define R_IS 5 // define pin 5 for R_IS pin (output)

#define LPWM 6 // define pin 6 for LPWM pin (output)
#define L_EN 7 // define pin 7 for L_EN pin (input)
#define L_IS 8 // define pin 8 for L_IS pin (output)
#define CW 1 //do not change
#define CCW 0 //do not change

//DC Motor Object
RobojaxBTS7960 motor(R_EN, RPWM, R_IS, L_EN, LPWM, L_IS, 1);

//Threads
Thread uState = Thread();
Thread applyControl = Thread();
ThreadController threads = ThreadController();

//Encoder Pins
#define w1 18
#define g1 19
#define w2 20
#define g2 21

//Encoder Signals
long counter1 = 0;
long counter2 = 0;

//System References
float centerPos;
float pendulumDownAngle;
float pendulumUpAngle;

//System State
float x[5];
float startTime;
float lastPosUpdate;
float lastAngUpdate;
int n = 0;

//System Parameters
float r = .021;

//Control Data
const float K1[302] PROGMEM = {-1.0503, -1.0526, -1.0550, -1.0573, -1.0597, -1.0621, -1.0644, -1.0666, -1.0687, -1.0707, -1.0725, -1.0742, -1.0757,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 1.0000, 1.0000};
const float K2[302] PROGMEM = {1.8867, 1.8908, 1.8948, 1.8987, 1.9023, 1.9057, 1.9088, 1.9116, 1.9140, 1.9160, 1.9176, 1.9188, 1.9195,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 -4.8395, -4.8395};
const float K3[302] PROGMEM = {-0.3307, -0.3334, -0.3362, -0.3390, -0.3418, -0.3445, -0.3472, -0.3498, -0.3523, -0.3546, -0.3567, -0.3586, -0.3602,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 1.8095, 1.8100};
const float K4[302] PROGMEM = {0.0831, 0.0821, 0.0811, 0.0801, 0.0791, 0.0781, 0.0771, 0.0761, 0.0752, 0.0742, 0.0734, 0.0726, 0.0718,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 -1.0090, -1.0090};
const float uk[302] = {0.0119, 0.0373, 0.0627, 0.0880, 0.1131, 0.1379, 0.1625, 0.1867, 0.2105, 0.2338, 0.2565, 0.2787, 0.3001,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 -0.0015, 0};
const float tk[302] = {0.0000, 0.0100, 0.0200, 0.0300, 0.0400, 0.0500, 0.0600, 0.0700, 0.0800, 0.0900, 0.1000, 0.1100, 0.1200,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 3.0000, 3.0100};
const float x1[302] PROGMEM = {0.0000, 0.0000, 0.0001, 0.0003, 0.0007, 0.0013, 0.0021, 0.0032, 0.0045, 0.0062, 0.0082, 0.0105, 0.0131,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 0.2756,0};
const float x2[302] PROGMEM = {-3.1416, -3.1416, -3.1418, -3.1423, -3.1433, -3.1447, -3.1467, -3.1494, -3.1527, -3.1567, -3.1615, -3.1670, -3.1732,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 -0.0207,0};
const float x3[302] PROGMEM = {0.0000, 0.0032, 0.0129, 0.0277, 0.0468, 0.0694, 0.0947, 0.1222, 0.1513, 0.1818, 0.2131, 0.2451, 0.2773,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 0.3026,0};
const float x4[302] PROGMEM = {0.0000, -0.0080, -0.0316, -0.0680, -0.1148, -0.1697, -0.2310, -0.2971, -0.3666, -0.4384, -0.5113, -0.5844, -0.6569,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 0.6379,0};

void setup() {
  Serial.begin(115200);

  //Motor
  motor.begin();

  // Threads
  uState.onRun(updateState);
  uState.setInterval(10);
  applyControl.onRun(controller);
  applyControl.setInterval(20);
  threads.add(&uState);
  threads.add(&applyControl);
  
  // Limit Switch PinsSetip
  pinMode(limLPin,INPUT_PULLUP);
  pinMode(limRPin,INPUT_PULLUP);

  // Encoder Pin Setup
  pinMode(w1, INPUT_PULLUP);
  pinMode(g1, INPUT_PULLUP);
  attachInterrupt(digitalPinToInterrupt(g1), encoder1PinChange, CHANGE);
  pinMode(w2, INPUT_PULLUP);
  pinMode(g2, INPUT_PULLUP);
  attachInterrupt(digitalPinToInterrupt(g2), encoder2PinChange, CHANGE);
  
  getDownAngle();
  centerGantry();

  initializeState();
}

void loop() {

  if(digitalRead(limRPin) == 0 || digitalRead(limLPin) == 0){
    motor.stop();
  }
  else{
    threads.run();
  }
  
}

void getDownAngle(){

    float minAngle = getPendAng();
    float maxAngle = getPendAng();

    float sTime = micros();
    float ang;

    while(micros() <= sTime + 5000000){
      ang = getPendAng();
      if(minAngle>ang){
        minAngle = ang;
      }
      if(maxAngle<ang){
        maxAngle = ang;
      }
    }

    pendulumDownAngle = (maxAngle+minAngle)/2;
    pendulumUpAngle = pendulumDownAngle + 3.14159;
}

void centerGantry(){

  while(digitalRead(limRPin) == 1){
    motor.rotate(15,CW);
  }
  motor.stop();
  float rightPos = getPos();

  while(digitalRead(limLPin) == 1){
    motor.rotate(15,CCW);
  }
  motor.stop();
  float leftPos = getPos();

  centerPos = (rightPos+leftPos)/2+.2;

  float sTime = micros();
  float integral = 0;
  float oldTime = micros();
  float newTime = micros();
  float uCom;
  
  while(newTime-sTime<=3000000 and digitalRead(limRPin) == 1){
    oldTime = newTime;
    newTime = micros();
    integral = integral + (getPos()-centerPos)*(newTime-oldTime)/(1000000);
    uCom = (1.25*(getPos()-centerPos)+.25*integral)*100;
    if(uCom >= 0){
      motor.rotate(uCom,CW);
    }
    else{
      motor.rotate(-uCom,CCW);
    }
  }
  motor.stop();
}

float getPendAng(){
  float angle;
  angle = -counter1/1200.0*2*3.14159;
  return angle;
}

float getPos(){
  float pos;
  pos = counter2/1200.0*2*3.14159*r;
  return pos;
}

void initializeState(){
  
  x[0] = centerPos-getPos();
  x[1] = getPendAng() - pendulumUpAngle;
  x[2] = 0;
  x[3] = 0;
  startTime = micros();
  lastPosUpdate = startTime;
  lastAngUpdate = startTime;
  
}

//void updatePos(){
//  float newPos = centerPos-getPos();
//  float nextTime = micros();
//  
//  x[2]= (newPos-x[0])*1000000/(nextTime - lastPosUpdate);
//  x[0] = newPos;
//
//  lastPosUpdate = nextTime;
//}

//void updateAng(){
//  float newAng = getPendAng() - pendulumUpAngle;
//  float nextTime = micros();
//  
//  x[3]= (newAng-x[1])*1000000/(nextTime - lastAngUpdate);
//  x[1] = newAng;
//
//  lastAngUpdate = nextTime;
//}

void updateState(){
  float newPos = centerPos-getPos();
  float newAng = getPendAng() - pendulumUpAngle;

  float nextTime = (micros()-startTime)/1000000;

  x[2] = (newPos-x[0])/(nextTime-x[4]);
  x[3] = (newAng - x[1])/(nextTime-x[4]);
  x[0] = newPos;
  x[1] = newAng;
  x[4] = nextTime;

}

void controller(){
  n = closest(tk,(micros()-startTime)/1000000,n);
  float uCom = uk[n]
  + pgm_read_float(&K1[n])*(x[0]-pgm_read_float(&x1[n])) + pgm_read_float(&K2[n])*(x[1]-pgm_read_float(&x2[n])) + pgm_read_float(&K3[n])*(x[2]-pgm_read_float(&x3[n])) + pgm_read_float(&K4[n])*(x[3]-pgm_read_float(&x4[n]));
  
//  Serial.print(pgm_read_float(&K1[n]));
//  Serial.print(" ");
//  Serial.print((x[0]-pgm_read_float(&x1[n])));
//  Serial.print(" | ");
//  Serial.print(pgm_read_float(&K2[n]));
//  Serial.print(" ");
//  Serial.print((x[1]-pgm_read_float(&x2[n])));
//  Serial.print(" | ");
//  Serial.print(pgm_read_float(&K3[n]));
//  Serial.print(" ");
//  Serial.print(x[2]-pgm_read_float(&x3[n]));
//  Serial.print(" | ");
//  Serial.print(pgm_read_float(&K4[n]));
//  Serial.print(" ");
//  Serial.print(x[3]-pgm_read_float(&x4[n]));
//  Serial.print(" | ");
//  Serial.print(uCom);
//  Serial.print(" ");
//  Serial.println(n);
  
  
  if(uCom>=0){
    motor.rotate(min(uCom*100,100),CW);
  }
  else{
    motor.rotate(min(-uCom*100,100),CCW);
  }

  Serial.print("Input Command: ");
  Serial.print(uCom);
  Serial.print("Time: ");
  Serial.print((micros()-startTime)/1000000);
  Serial.print(" Current Position: ");
  Serial.print(x[0]);
  Serial.print(" Current Angle: ");
  Serial.print(x[1]);
  Serial.print(" Current Position Rate: ");
  Serial.print(x[2]);
  Serial.print(" Current Angle Rate: ");
  Serial.println(x[3]);
  
}

void encoder1PinChange() {
counter1 += digitalRead(g1) == digitalRead(w1) ? -1 : 1;
}

void encoder2PinChange() {
counter2 += digitalRead(g2) != digitalRead(w2) ? -1 : 1;
}

int closest(const float arr[],float val,int startIndex){

  //float dif = abs(pgm_read_float(&arr[0])-val);
  float dif = abs(arr[startIndex]-val);
  float minVal = dif;
  int index = startIndex;
  bool lastMin = true;
  for(int i = startIndex+1; i<=301; i++){
    dif = abs(arr[i]-val);
    if(dif<minVal){
      minVal = dif;
      index = i;
    }
    else{
      break;
    }
  }
  return index;
}
